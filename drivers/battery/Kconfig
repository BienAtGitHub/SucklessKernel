## drivers/battery/Kconfig
```kconfig
config BATTERY_SAMSUNG
	tristate "samsung battery driver"
	help
	 Say Y to include support for samsung battery driver
	 This battery driver integrated all battery-related functions
	 To see battery-related functions,
	 refer to sec_charging_common.h

config PREVENT_SOC_JUMP
	tristate "prevent soc jump at full-charged"
	default n
	depends on BATTERY_SAMSUNG
	help
	 Say Y to prevent soc jump

config BATTERY_SWELLING
	bool "prevent battery swelling"
	help
	  Say Y to include support for prevent battery swelling

config BATTERY_SWELLING_SELF_DISCHARGING
	bool "prevent battery swelling with self discharging"
	help
	  Say Y to include support for prevent battery swelling with self discharging

config SW_SELF_DISCHARGING
	bool "enable sw_self_discharging"
	default n
	help
	  Say Y to enable CONFIG_SW_SELF_DISCHARGING

config CALC_TIME_TO_FULL
	tristate "calculate time to full"
	default n
	depends on BATTERY_SAMSUNG
	help
	Say Y to use calc time to full function.

config BATTERY_AGE_FORECAST
	tristate "battery age forecast"
	default n
	help
	Say Y to use battery age forecast

config BATTERY_AGE_FORECAST_DETACHABLE
	tristate "battery age forecast for detachable"
	default n
	select BATTERY_AGE_FORECAST
	help
	Say Y to use battery age forecast for detachable

# Fuel Gauge

config FUELGAUGE_S2MU005
	tristate "S2MU005 fuel gauge driver"
	default n
	depends on BATTERY_SAMSUNG
	help
	  Say Y to include support
	  for S.LSI S2MU005 fuel gauge driver.

# Charger

config CHARGER_S2MU005
	tristate "S2MU005 charger support"
	depends on (MFD_S2MU005) && I2C
	help
	  Say Y here to enable support for the S2MU005 charger
	  S2MU005 incluse pmic, led driver.
	  You have to define MFD_S2MU005

config AFC_CHARGER_MODE
	bool "afc charging support in sec battery driver"
	default n
	depends on BATTERY_SAMSUNG
	help
	  Say Y to include support for sec afc charging support

config EN_OOPS
	bool "enable oops filter"
	default n
	help
	  Say Y to enable oops filter

config STORE_MODE
       bool "enable store mode"
       default n
       help
	 Say Y to enable CONFIG_STORE_MODE
```

## drivers/battery_v2/Kconfig
```kconfig
config BATTERY_SAMSUNG
	tristate "samsung battery driver"
	help
	 Say Y to include support for samsung battery driver
	 This battery driver integrated all battery-related functions
	 To see battery-related functions,
	 refer to sec_charging_common.h

config BATTERY_SAMSUNG_V2
	tristate "samsung battery driver version 2"
	default n
	depends on BATTERY_SAMSUNG
	help
	 Say Y to include support for samsung battery driver
	 This battery driver integrated all battery-related functions
	 To see battery-related functions,
	 refer to sec_charging_common.h

config BATTERY_SWELLING
	bool "prevent battery swelling"
	help
	  Say Y to include support for prevent battery swelling

config BATTERY_SWELLING_SELF_DISCHARGING
	bool "prevent battery swelling with self discharging"
	help
	  Say Y to include support for prevent battery swelling with self discharging

config CALC_TIME_TO_FULL
	tristate "calculate time to full"
	default n
	depends on BATTERY_SAMSUNG
	help
	  Say Y to use calc time to full function.

config SW_SELF_DISCHARGING
	bool "enable sw_self_discharging"
	default n
	help
	  Say Y to enable CONFIG_SW_SELF_DISCHARGING

config BATTERY_AGE_FORECAST_B2B
	tristate "battery age forecast for B2B"
	default n
	select BATTERY_AGE_FORECAST
	help
	Say Y to use battery age forecast for B2B

config FUELGAUGE_ASOC_FROM_CYCLES
	bool "FUELGAUGE ASOC output based on mapping with battery cycles"
	default n
	depends on BATTERY_AGE_FORECAST
	help
	 Say Y to enable support for the mapping of ASOC with charging cycles.
	 Support for this feature implies that a mapping table has been shared
	 from HW team and big data side. This feature is providing
	 support for platform required battery health monitoring concepts.

config DCM_JPN_CONCEPT_FG_CYCLE_CHECK
	bool "enable fg_cycle_check_value for dcm jpn"
	default n
	help
	 Say Y to use fg_cycle_check_value.

config MULTI_CHARGING
	bool "support for multi charger ICs"
	help
	Say Y to include support for multi charger ICs

config BATTERY_AGE_FORECAST_DETACHABLE
	tristate "battery age forecast for detachable"
	default n
	select BATTERY_AGE_FORECAST
	help
	Say Y to use battery age forecast for detachable

config STEP_CHARGING
	bool "support for step charging"
	help
	 Say Y to include support for step charging

config BATTERY_CISD
	bool "support for cisd"
	help
	 Say Y to include support for cisd
	 cisd means cell internal short detection

config UPDATE_BATTERY_DATA
	bool "support for updating battery data"
	default n
	depends on BATTERY_SAMSUNG && OF
	help
	 Say Y to include support for step charging

config SAMSUNG_BATTERY_ENG_TEST
	tristate "set test mode in eng build"
	default n
	depends on BATTERY_SAMSUNG
	help
	 Say Y to set test mode in eng build

# Fuel Gauge

config FUELGAUGE_S2MU005
	tristate "S2MU005 fuel gauge driver"
	default n
	depends on BATTERY_SAMSUNG
	help
	  Say Y to include support
	  for S.LSI S2MU005 fuel gauge driver.
 
# Charger

config CHARGER_S2MU005
	tristate "S2MU005 charger support"
	depends on (MFD_S2MU005) && I2C
	help
	  Say Y here to enable support for the S2MU005 charger
	  S2MU005 incluse pmic, led driver.
	  You have to define MFD_S2MU005

config S2MU005_INNER_BATTERY
	tristate "S2MU005 inner battery type"
	depends on (MFD_S2MU005) && I2C
	help
	  Say Y here to enable support marking project using S2MU005
	  which use internal battery type
	  You have to define MFD_S2MU005

config WIRELESS_CHARGER_HIGH_VOLTAGE
	tristate "high voltage wireless charger"
	depends on BATTERY_SAMSUNG && I2C
	help
	  Say Y here to enable support for the wireless charger charger
	  driver.

config EN_OOPS
	bool "enable oops filter"
	default n
	help
	  Say Y to enable oops filter

config USE_POGO
       bool "enable pogo charging"
       default n
       help
	 Say Y to enable CONFIG_USE_POGO

config STORE_MODE
       bool "enable store mode"
       default n
       help
	 Say Y to enable CONFIG_STORE_MODE

config BATTERY_NOTIFIER
	bool "battery notifier"
	default n
	help
	  Say Y to enable battery notifier
	  
config XADC_SHARE_BATT_WITH_USB_THM
	bool "To use xadc mux for BAT_THM with USB_THM"
	default n
	help
	  Say Y to enable use xadc mux for BAT_THM with USB_THM

config THM_MUX_SHARE
	bool "To use xadc mux for BAT_THM with AP_THM"
	default n
	help
	  Say Y to enable use xadc mux for BAT_THM with AP_THM
	  
config S2MU005_EVT4_DISABLE_BUCK_MODE
	bool "Disable buck only mode in S2MU005X03"
	default n
	depends on CHARGER_S2MU005
	help
	  Say Y to enable use all-off mode in S2MU005X03

config ENABLE_100MA_CHARGING_BEFORE_USB_CONFIGURED
	bool "enable 100mA before usb configured"
	default n
	help
	  Say Y to enable 100mA before usb configured

config S2MU005_MODE_CHANGE_BY_TOPOFF
	bool "enable s2mu005 mode change by topoff"
	default n
	help
	  Say Y to enable s2mu005 mode change by topoff

config ABNORMAL_BAT_THM_WA
	bool "enable SW Workaround for abnormal jump in battery thermistor ADC"
	default n
	help
	  Say Y to enable SW Workaround for abnormal jump in battery thermistor ADC

config TYPEB_WATERPROOF_MODEL
	bool "enable typeb_waterproof_model"
	default n
	help
	  Say Y here to enable typeb_waterproof_model
```

## drivers/bts/Kconfig
```kconfig
#
# BTS driver configuration
#

menuconfig EXYNOS_BTS
	bool "BTS driver support"
	default y
	help
	  Enable BTS (Bus traffic shaper) support

if EXYNOS_BTS

config EXYNOS7870_BTS
	bool "Bus traffic shaper support"
	default y
	depends on SOC_EXYNOS7870
	help
	  Enable BTS (Bus traffic shaper) support
endif
```

## drivers/gud/Kconfig
```kconfig
#
# Mobicore Configuration
#

if SOC_EXYNOS7870
source "drivers/gud/gud-exynos7870/Kconfig"
endif
```
